## board/kubos/pumpkin-mbm2/Kconfig
```kconfig
if TARGET_PUMPKIN_MBM2

config SPL_ENV_SUPPORT
	default y

config SPL_WATCHDOG_SUPPORT
	default y

config SPL_YMODEM_SUPPORT
	default y

config SYS_BOARD
	default "pumpkin-mbm2"

config SYS_VENDOR
	default "kubos"

config SYS_SOC
	default "am33xx"

config SYS_CONFIG_NAME
	default "pumpkin-mbm2"

config CONS_INDEX
	int "UART used for console"
	range 1 6
	default 1
	help
	  The AM335x SoC has a total of 6 UARTs (UART0 to UART5 as referenced
	  in documentation, etc) available to it.  Depending on your specific
	  board you may want something other than UART0 as for example the IDK
	  uses UART3 so enter 4 here.

config BOOTDEV_DETECT
    bool "Use automatic detection of boot device"
    default y
    
source "board/ti/common/Kconfig"

endif
```

## configs/pumpkin-mbm2_defconfig
```kconfig
CONFIG_ARM=y
CONFIG_TARGET_PUMPKIN_MBM2=y
CONFIG_BOOTDELAY=0
CONFIG_USB_OHCI_HCD=y
# CONFIG_SPL_NAND_SUPPORT is not set
CONFIG_SPL_STACK_R_ADDR=0x82000000
CONFIG_SPL=y
CONFIG_SPL_STACK_R=y
CONFIG_HUSH_PARSER=y
CONFIG_SYS_PROMPT="U-Boot> "
CONFIG_CMD_BOOTZ=y
CONFIG_CMD_MEMINFO=y

# The two comments below seem to be needed to actually disable these flags (?).
# CONFIG_CMD_IMLS is not set
# CONFIG_CMD_FLASH is not set

CONFIG_CMD_ASKENV=y
CONFIG_CMD_MMC=y
CONFIG_CMD_SPI=y
CONFIG_CMD_I2C=y
CONFIG_CMD_USB=y
CONFIG_CMD_DFU=y
CONFIG_CMD_GPIO=y
CONFIG_CMD_DHCP=y
CONFIG_CMD_MII=y
CONFIG_CMD_PING=y
CONFIG_CMD_EXT2=y
CONFIG_CMD_EXT4=y
CONFIG_CMD_EXT4_WRITE=y
CONFIG_CMD_FAT=y
CONFIG_CMD_FS_GENERIC=y
CONFIG_CMD_FITUPD=y
# CONFIG_CMD_SETEXPR is not set
CONFIG_DFU=y
CONFIG_DFU_TFTP=y
CONFIG_DFU_MMC=y
CONFIG_SYS_NS16550=y
CONFIG_USB=y
CONFIG_USB_MUSB_HOST=y
CONFIG_USB_MUSB_GADGET=y
CONFIG_SPL_MUSB_NEW_SUPPORT=y
CONFIG_USB_STORAGE=y
CONFIG_USB_GADGET=y
CONFIG_USB_GADGET_DOWNLOAD=y
CONFIG_G_DNL_MANUFACTURER="Texas Instruments"
CONFIG_G_DNL_VENDOR_NUM=0x0451
CONFIG_G_DNL_PRODUCT_NUM=0xd022
CONFIG_OF_LIBFDT=y
CONFIG_FIT=y
CONFIG_FIT_VERBOSE=y
CONFIG_FIT_SIGNATURE=y

# Use the kubos image update feature
CONFIG_UPDATE_KUBOS=y

# Use the bootdev_detect instead of hardcoded device and partition settings
CONFIG_BOOTDEV_DETECT=y
```
